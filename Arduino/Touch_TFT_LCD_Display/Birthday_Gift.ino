// Author: D. Krishna Swaroop

/*
  The start-up animation plays upon powering-on/reset. Displays a starting screen which needs a touch input to proceed further. From here, you can use the Next/Back 'buttons' on
  the display to navigate. 
  Displays a basic menu interface to act as a digital greeting card that utilises all the features of the Touchscreen TFT LCD Display except the SD card functionality.
  Didn't put in an escape path from the last "page". Should be pretty straightforward to add that, just add another if-else condition near line 479.
  Please bear with the bugs if there are any. Coded this in 2 hrs. Uses 89% of program memory and 39% of dynamic memory. Highly inefficient and has bad coding standards
  Heavily uses the Adafruit libraries for interfacing with the display. The display I have is a cheap chinese knock-off. So I had to use the MCUFRIEND_kbv library to get it
  up and running.
  
  Further improvements could be to make proper header files for all the functions/bitmaps, make functions for a lot of the repetitive code
  and keep the main function clean and simple. 
  
  If you're planning on using this for the same purpose, be sure to change the name of the person you're gifting this to :))
*/

////////////////////////////////////////////////////////////////////////////////////////////////////////////////////////////////////////////////////////////////////////
#include <SPI.h>          
#include "Adafruit_GFX.h"
#include <MCUFRIEND_kbv.h>
#include <TouchScreen.h>
// #include <avr/pgmspace.h>
#include <Adafruit_TFTLCD.h>

#define LCD_CS A3 // Chip Select goes to Analog 3
#define LCD_CD A2 // Command/Data goes to Analog 2
#define LCD_WR A1 // LCD Write goes to Analog 1
#define LCD_RD A0 // LCD Read goes to Analog 0
#define LCD_RESET A4 // Can alternately just connect to Arduino's reset pin

MCUFRIEND_kbv tft;

const int XP=7,XM=A1,YP=A2,YM=6; //240x320 ID=0x6809;
const int TS_LEFT=930,TS_RT=180,TS_TOP=169,TS_BOT=919;

const unsigned char BalloonBitmap [] PROGMEM = {
	// '325060 (1), 30x74px
	0x00, 0x00, 0x00, 0x00, 0x00, 0x00, 0x00, 0x00, 0x00, 0x00, 0x00, 0x00, 0x00, 0x00, 0x00, 0x00, 
	0x00, 0x00, 0x00, 0x00, 0x00, 0x00, 0x00, 0x00, 0x00, 0x00, 0x00, 0x00, 0x00, 0x00, 0x00, 0x00, 
	0x00, 0x00, 0x00, 0x00, 0x00, 0x00, 0x00, 0x00, 0x00, 0x00, 0x00, 0x00, 0x00, 0x00, 0x00, 0x00, 
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	0x00, 0x00, 0x00, 0x00, 0x00, 0x00, 0x00, 0x00
}; // tft.drawBitmap(x,y, BalloonBitmap, 30,74, HOTPINK);

// PIKAPIKA BITCH
const unsigned char PIKAPIKA [] PROGMEM = { // tft.drawBitmap(x,y, PIKAPIKA, 240,180, YELLOW);
	// PIKAPIKA, 240x180px
	0x00, 0x0f, 0xff, 0xff, 0xff, 0xff, 0xf8, 0x00, 0x00, 0x00, 0x00, 0x00, 0x00, 0x00, 0x00, 0x00, 
	0x00, 0x00, 0x00, 0x00, 0x00, 0x00, 0x00, 0x00, 0x00, 0x00, 0x00, 0x00, 0x00, 0x00, 0x00, 0x0f, 
	0xff, 0xff, 0xff, 0xff, 0xfe, 0x00, 0x00, 0x00, 0x00, 0x00, 0x00, 0x00, 0x00, 0x00, 0x00, 0x00, 
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	0xff, 0xff, 0xff, 0xff, 0xff, 0xff, 0xff, 0xff
};

uint8_t PORTRAIT = 0;    //PORTRAIT
uint8_t LANDSCAPE = 1;   // Landscape
uint8_t currentState;
uint8_t Direction;

TouchScreen ts = TouchScreen(XP, YP, XM, YM, 300);
TSPoint tp;

#define MINPRESSURE 200
#define MAXPRESSURE 1000

#define BACK 0
#define NEXT 1

// Assign human-readable names to some common 16-bit color values:
#define	BLACK   0x0000
#define WHITE   0xFFFF
#define HOTPINK 0xECF8


void setup() {
  // put your setup code here, to run once:
  Serial.begin(9600);
  uint32_t when = millis();
  //    while (!Serial) ;             //hangs a Leonardo until you connect a Serial
  if (!Serial) delay(1000);           //allow some time for Leonardo
  Serial.println("Serial took " + String((millis() - when)) + "ms to start");

  ///////////////////////////////////////////////////////////////////////////
  delay(1000); //Add this delay for final code
  tft.reset();                                    //hardware reset
  uint16_t ID = tft.readID(); 
  Serial.print("ID = 0x");
  Serial.println(ID, HEX);
  if (ID == 0xD3D3) ID = 0x9481;                 // write-only shield
  //    ID = 0x9329;                             // force ID
  tft.begin(ID);
  ///////////////////////////////////////////////////////////////////////////
  
  transitionAnimation();
  delay(1000);
  drawHomeScreen();
  /* Test Code
        // tft.fillScreen(HOTPINK);
        tft.drawLine(0,250,240,250, WHITE);
  */
  //////////////////////////////////////////////////////////////////////////
  currentState = 0;
}

void loop() {
  // Getting TouchScreen Input to determine 
  uint8_t Orientation = PORTRAIT;
  uint16_t xpos, ypos;  //screen coordinates
  tp = ts.getPoint();   //tp.x, tp.y are ADC values

  // if sharing pins, you'll need to fix the directions of the touchscreen pins
  pinMode(XM, OUTPUT);
  pinMode(YP, OUTPUT);
  // we have some minimum pressure we consider 'valid'
  // pressure of 0 means no pressing!

  if (tp.z > MINPRESSURE && tp.z < MAXPRESSURE) {
    // most mcufriend have touch (with icons) that extends below the TFT
    // screens without icons need to reserve a space for "erase"
    // scale the ADC values from ts.getPoint() to screen values e.g. 0-239
    //
    // Calibration is true for PORTRAIT. tp.y is always long dimension 
    // map to your current pixel orientation
      
    switch (Orientation) {
        case 0:
            xpos = map(tp.x, 930, 180, 0, 240);
            ypos = map(tp.y, 169, 919, 0, 320);
            break;
        case 1:
            xpos = map(tp.y, 169, 919, 0, 320);
            ypos = map(tp.x, 180, 930, 0, 240);
            break;
    }
    // Serial.print("xpos = ");
    // Serial.println(xpos, DEC);

    if (ypos>245){
      if (xpos<120){
        Direction = BACK;        
      }
      else {
        Direction = NEXT;
      }
      stateChange(Direction);
    }
  } 
}


void stateChange(int direction) {
  if (direction){
    currentState++;
  }
  else {
    currentState--;    
  }
  switch (currentState) {
    case 1:
      initSlideShow();
      break;
    case 2:
      drawPageOne();
      break;
    case 3:
      drawPageTwo();
      break;
    default: currentState=0;
  }
}

void drawHomeScreen(void) {
  tft.fillScreen(WHITE);
  tft.drawRoundRect(0, 0, 240, 310, 8, WHITE); 
  tft.setTextSize(2);
  tft.setTextColor(HOTPINK);
  tft.setCursor(50, 20);
  tft.print("Hey Stranger!");
  tft.setTextSize(4);
  tft.drawBitmap(105,30, BalloonBitmap, 30,74, HOTPINK);
  tft.drawBitmap(10,30, BalloonBitmap, 30,74, HOTPINK);
  tft.drawBitmap(200,30, BalloonBitmap, 30,74, HOTPINK);
  delay(1000);
  tft.setCursor(40, 110);
  tft.print("Welcome");
  tft.setTextSize(3);
  tft.setCursor(50, 140);
  tft.print("to this");
  tft.setCursor(40, 170);
  tft.print("Glorified");
  tft.setCursor(40, 200);
  tft.print("Gift Card");
  tft.drawBitmap(105,240, BalloonBitmap, 30,74, HOTPINK);
  tft.drawBitmap(10,240, BalloonBitmap, 30,74, HOTPINK);
  tft.drawBitmap(200,240, BalloonBitmap, 30,74, HOTPINK);
}

void initSlideShow(void) {
  // Add UI Elements or slide contents here
  tft.fillScreen(BLACK);
  // testFilledTriangles(HOTPINK);

  // Page Border
  transitionAnimation();
  delay(300);
  tft.drawRoundRect(0, 0, 240, 310, 8, WHITE);
  tft.fillRoundRect(2, 2, 235, 305 , 8, WHITE);
  tft.fillRoundRect(7, 7, 225, 295 , 8, HOTPINK);
  // HAPPY BIRTHDAY JAANVI!
  tft.fillRoundRect(12,12, 130, 40,8, WHITE);
  tft.setCursor(20,20);
  tft.setTextColor(HOTPINK);
  tft.setTextSize(4);
  tft.print("HAPPY");
  tft.drawBitmap(170,0, BalloonBitmap, 30,74, WHITE);
  delay(300);  

  tft.fillRoundRect(12,62, 205, 40,8, WHITE);
  tft.setCursor(20,70);
  tft.setTextColor(HOTPINK);
  tft.setTextSize(4);
  tft.print("BIRTHDAY");
  delay(300);

  tft.fillRoundRect(12,112, 218, 40,8, WHITE);
  tft.setCursor(18,120);
  tft.setTextSize(4);
  tft.setTextColor(HOTPINK);
  tft.print("JAANVI!!!");
  delay(300);
  tft.drawBitmap(30,170, BalloonBitmap, 30,74, WHITE);
  tft.drawBitmap(80,170, BalloonBitmap, 30,74, WHITE);
  tft.drawBitmap(130,170, BalloonBitmap, 30,74, WHITE);
  tft.drawBitmap(180,170, BalloonBitmap, 30,74, WHITE);
  
  delay(2000);
  // Next Button
  insertNextButton(120,245);  
  // Back Button
  // insertBackButton();
  
  /////////////////////////////////////////
  /* Test Code
        //tft.fillScreen(BLACK);
        //delay(1000);
        // Touch Sensitive Areas for Back and Next  
        tft.drawLine(0,245,240,245, WHITE);
        tft.drawLine(120,245,120,310, WHITE);              
  */
  
}

void insertNextButton(int x , int y) {
  tft.fillRoundRect(x, y, 110, 55 , 8, WHITE);
  tft.fillRoundRect(x+5, y+5, 100, 45 , 8, HOTPINK);
  tft.setCursor(x+20,y+17);
  tft.setTextSize(3);
  tft.setTextColor(WHITE);
  tft.println("NEXT");
}
void insertBackButton(int x, int y){
  tft.fillRoundRect(x, y, 110, 55 , 8, WHITE);
  tft.fillRoundRect(x+5, y+5, 100, 45 , 8, HOTPINK);
  tft.setCursor(x+20,y+17);
  tft.setTextSize(3);
  tft.setTextColor(WHITE);
  tft.println("BACK");
}
void drawPageOne(void){
  // Design and add page elements 
  transitionAnimation();
  delay(300);
  tft.drawRoundRect(0, 0, 240, 310, 8, WHITE);
  tft.fillRoundRect(2, 2, 235, 305 , 8, WHITE);
  tft.fillRoundRect(7, 7, 225, 295 , 8, HOTPINK);

  tft.fillRoundRect(12,12, 200, 40,8, WHITE);
  tft.setCursor(20,20);
  tft.setTextColor(HOTPINK);
  tft.setTextSize(3);
  tft.print("Bro!You're");
  delay(300);

  tft.fillRoundRect(12,62, 215, 40,8, WHITE);
  tft.setCursor(20,70);
  tft.setTextColor(HOTPINK);
  tft.setTextSize(3);
  tft.print("23Years Old");
  delay(300);

  tft.fillRoundRect(12,162, 120, 50,8, WHITE);
  tft.setCursor(18,170);
  tft.setTextSize(5);
  tft.setTextColor(HOTPINK);
  tft.print("GG!!!");

  delay(2000);
  // Next Button
  insertNextButton(120,245);  
  // Back Button
  insertBackButton(10,245);

   /* Test Code
        tft.fillScreen(GREEN);
        delay(1000);
        tft.drawLine(0,160,240,160, WHITE);
        tft.drawLine(120,200,120,320, WHITE); 
        tft.drawBitmap(0,0, cropped, 240,180, YELLOW);
   */      
        
}
void drawPageTwo(void){
  // Design and add page elements 
  transitionAnimation();
  delay(300);
  tft.drawRoundRect(0, 0, 240, 310, 8, WHITE);
  tft.fillRoundRect(2, 2, 235, 305 , 8, WHITE);
  tft.fillRoundRect(7, 7, 225, 295 , 8, HOTPINK);
  tft.setCursor(10,15);
  tft.setTextSize(1);
  tft.setTextColor(WHITE);
  tft.print("Wishing you the best in whatever you    do!!\n");
  delay(500);
  tft.setCursor(10,35);
  tft.print("Sorry I couldn't get the satellite      painted fully Pink :(\n");
  delay(500);  
  tft.setCursor(10,55);
  tft.print("Hoping this fully compensates           for that :))\n");
  tft.setCursor(10,85);
  // Bummed that things didnt work out in other aspects but it is what it is. 
  tft.setTextSize(2);
  tft.print("         --Swaroop\n");  
  delay(500);
  tft.setCursor(10,125);
  tft.setTextSize(1);
  tft.print("Hopefully this is you after this....");
  delay(1500);
  tft.drawBitmap(0,140, PIKAPIKA, 240,180, WHITE);  


  /* Test Code
        tft.fillScreen(BLUE);
        tft.drawLine(0,160,240,160, WHITE);
        tft.drawLine(120,200,120,320, WHITE); 
        delay(1000);
  */      
}
void transitionAnimation() {
    // unsigned long start;
    int           w, i, i2, red, step,
                  cx = tft.width()  / 2 - 1,
                  cy = tft.height() / 2 - 1;

    tft.fillScreen(WHITE);
    w     = min(tft.width(), tft.height());
    // start = micros();
    red = 0;
    step = (256 * 6) / w;
    for (i = 0; i < w; i += 6) {
        i2 = i / 2;
        red += step;
        tft.drawRoundRect(cx - i2, cy - i2, i, i, i / 8, HOTPINK);
        delay(10);
    }

}

